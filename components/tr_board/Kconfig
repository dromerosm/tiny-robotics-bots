## components/tr_board/Kconfig
```kconfig
menu "tr_board"
    config TR_SLEEP_AFTER_S
        int "Seconds with no touch before the robot sleeps (0: never)"
        default 60
        range 0 3600
        help
            Only on battery: with USB power the robot never sleeps.
            POST /sleep?after=N (tr_web) changes it until the next restart.
endmenu
```

## components/tr_web/Kconfig
```kconfig
menu "tr_web"
    config TR_WEB_CAMERA
        bool "Serve camera frames at /camera.jpg"
        default y
        help
            Turn it off in an example without the camera. The camera code
            then stays out of the app, and the page hides its camera card.
endmenu
```
